## isar-demo/meta-gwr/conf/machine/gwr-common.inc
```bitbake
# Select our custom kernel recipe globally
PREFERRED_PROVIDER_virtual/kernel = "linux-xlnx"

# Force kernel version (wildcard allowed)
PREFERRED_VERSION_linux-xlnx = "6.1%"

KERNEL_NAME ?= "xlnx"

# Filenames to be copy into deploy dir
KERNEL_IMAGE = "Image"
#DTB_FILES = "k3-am642-sk.dtb"

# Kernel flavour must match recipe prefix: linux-xlnx_*.bb → flavour = xlnx
LINUX_FLAVOUR ?= "xlnx"

# ISAR-specific: which kernel package name to build
#KERNEL_PACKAGE = "linux-xlnx"

#KERNEL_IMAGE = "vmlinuz-6.1.0-xlnx"
```

## meta-gwr/conf/distro/include/gwr-ubuntu-jammy.inc
```bitbake
# GWR vendor image version pinning for Ubuntu Jammy
PREFERRED_VERSION_busybox-static = "1:1.30.1-7ubuntu3"
# Networking tools
PREFERRED_VERSION_ethtool = "1:5.16-1ubuntu0.1"
PREFERRED_VERSION_iptables = "1.8.7-1ubuntu5"
PREFERRED_VERSION_net-tools = "1.60+git20181103.0eebece-1ubuntu5"
# Editor
PREFERRED_VERSION_vim = "2:8.2.3995-1ubuntu2"
PREFERRED_VERSION_ca-certificates = "20211016"
PREFERRED_VERSION_curl = "7.81.0-1ubuntu1.6"
PREFERRED_VERSION_fdisk = "2.37.2-4ubuntu3"
PREFERRED_VERSION_file = "1:5.41-3"
# Networking + System Utilities version pinning
PREFERRED_VERSION_fru-print = "2022.1.6483e22-0ubuntu1~xlnx3"
PREFERRED_VERSION_gawk = "1:5.1.0-1build3"
PREFERRED_VERSION_i2c-tools = "4.3-2build1"
PREFERRED_VERSION_iproute2 = "5.15.0-1ubuntu2"
PREFERRED_VERSION_iptables = "1.8.7-1ubuntu5"
PREFERRED_VERSION_iputils-ping = "3:20211215-1"
PREFERRED_VERSION_isc-dhcp-client = "4.4.1-2.3ubuntu2.3"
PREFERRED_VERSION_isc-dhcp-common = "4.4.1-2.3ubuntu2.3"
PREFERRED_VERSION_less = "590-1build1"
PREFERRED_VERSION_lsb-release = "11.1.0ubuntu4"
PREFERRED_VERSION_openssh-client = "1:8.9p1-3"
PREFERRED_VERSION_openssh-server = "1:8.9p1-3"
PREFERRED_VERSION_openssh-sftp-server = "1:8.9p1-3"
PREFERRED_VERSION_openssl = "3.0.2-0ubuntu1.7"
PREFERRED_VERSION_python3 = "3.10.6-1~22.04"
PREFERRED_VERSION_rsyslog = "8.2112.0-2ubuntu2.2"
PREFERRED_VERSION_tcpdump = "4.99.1-3build2"
PREFERRED_VERSION_time = "1.9-0.1build2"
PREFERRED_VERSION_tzdata = "2022f-0ubuntu0.22.04.1"
PREFERRED_VERSION_unzip = "6.0-26ubuntu3.1"
PREFERRED_VERSION_zip = "3.0-12build2"
```

## meta-gwr/conf/layer.conf
```bitbake
# This software is a part of isar demo.
# Copyright (c) Siemens AG, 2025
#
# SPDX-License-Identifier: MIT

BBPATH .= ":${LAYERDIR}"

BBFILES += "${LAYERDIR}/recipes-*/*/*.bb \
        ${LAYERDIR}/recipes-*/*/*.bbappend"

BBFILE_COLLECTIONS += "meta-gwr"
BBFILE_PATTERN_meta-gwr = "^${LAYERDIR}/recipes-"
BBFILE_PRIORITY_meta-gwr = "6"

LAYERSERIES_COMPAT_meta-gwr = "next"

LAYERDIR_meta-gwr = "${LAYERDIR}"
```

## meta-mplane/conf/layer.conf
```bitbake
#BBPATH .= ":${LAYERDIR}"
#BBFILES += "${LAYERDIR}/recipes-mplane/**/*/*.bb"

#BBFILE_COLLECTIONS += "mplane"
#BBFILE_PATTERN_mplane := "^${LAYERDIR}/"
#BBFILE_PRIORITY_mplane = "9"



BBPATH .= ":${LAYERDIR}"

BBFILES += "${LAYERDIR}/recipes-*/*/*.bb \
        ${LAYERDIR}/recipes-*/*/*.bbappend"

BBFILE_COLLECTIONS += "meta-mplane"
BBFILE_PATTERN_meta-mplane = "^${LAYERDIR}/recipes-"
BBFILE_PRIORITY_meta-mplane = "9"

LAYERSERIES_COMPAT_meta-mplane = "next"

LAYERDIR_meta-mplane = "${LAYERDIR}"
```

## meta-z19/conf/layer.conf
```bitbake
# This software is a part of isar demo.
# Copyright (c) Siemens AG, 2025
#
# SPDX-License-Identifier: MIT

BBPATH .= ":${LAYERDIR}"

BBFILES += "${LAYERDIR}/recipes-*/*/*.bb \
        ${LAYERDIR}/recipes-*/*/*.bbappend"

BBFILE_COLLECTIONS += "meta-z19"
BBFILE_PATTERN_meta-z19 = "^${LAYERDIR}/recipes-"
BBFILE_PRIORITY_meta-z19 = "7"

LAYERSERIES_COMPAT_meta-z19 = "next"

LAYERDIR_meta-z19 = "${LAYERDIR}"
```

## meta-z19/conf/machine/z19-arm64-jammy.conf
```bitbake
# Base generic ARM64 machine
require conf/machine/gwr-common.inc

DESCRIPTION = "GWR Z19 Board"

# Mandatory architecture variables
DISTRO_ARCH = "arm64"
PACKAGE_ARCH = "arm64"

# Optional: device tree name
MACHINE_DEVICETREE = "zynqmp-zcu102-rev.0.dts"
```
